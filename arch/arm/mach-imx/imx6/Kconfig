## arch/arm/mach-imx/imx6/Kconfig
```kconfig
if ARCH_IMX6

config IMX6_SMP
	select ARM_ERRATA_751472
	select ARM_ERRATA_761320
	select ARM_ERRATA_794072
	select ARM_ERRATA_845369
	bool

config IMX6
	select ARM_ERRATA_743622 if !IMX6UL
	bool
	default y
	imply CMD_FUSE

config IMX6D
	select IMX6_SMP
	bool

config IMX6DL
	select IMX6_SMP
	bool

config IMX6Q
	select IMX6_SMP
	bool

config IMX6QDL
	select IMX6_SMP
	bool

config IMX6S
	bool

config IMX6SL
	bool

config IMX6SX
	select ROM_UNIFIED_SECTIONS
	bool

config IMX6SLL
	select ROM_UNIFIED_SECTIONS
	bool

config IMX6UL
	select SYS_L2CACHE_OFF
	select ROM_UNIFIED_SECTIONS
	bool

config IMX6UL_LITESOM
	bool
	select IMX6UL
	select DM
	select DM_THERMAL
	select SUPPORT_SPL

config IMX6UL_OPOS6UL
	bool
	select IMX6UL
	select BOARD_LATE_INIT
	select DM
	select DM_GPIO
	select DM_MMC
	select DM_THERMAL
	select SUPPORT_SPL

config IMX6ULL
	bool
	select IMX6UL

config IMX6_DDRCAL
	bool "Include dynamic DDR calibration routines"
	depends on SPL
	default n
	help
	  Say "Y" if your board uses dynamic (per-boot) DDR calibration.
	  If unsure, say N.

choice
	prompt "IMX6 board select"
	optional

config TARGET_ADVANTECH_DMS_BA16
	bool "Advantech dms-ba16"
	select BOARD_LATE_INIT
	select IMX6Q
	imply CMD_SATA

config TARGET_APALIS_IMX6
	bool "Toradex Apalis iIMX6 board"
	select BOARD_LATE_INIT
	select SUPPORT_SPL
	select DM
	select DM_SERIAL
	select DM_THERMAL
	imply CMD_SATA

config TARGET_ARISTAINETOS
	bool "aristainetos"

config TARGET_ARISTAINETOS2
	bool "aristainetos2"
	select BOARD_LATE_INIT

config TARGET_ARISTAINETOS2B
	bool "Support aristainetos2-revB"
	select BOARD_LATE_INIT

config TARGET_CGTQIMX6EVAL
	bool "cgtqimx6eval"
	select BOARD_LATE_INIT
	select SUPPORT_SPL
	select DM
	select DM_THERMAL

config TARGET_CM_FX6
	bool "CM-FX6"
	select SUPPORT_SPL
	select DM
	select DM_SERIAL
	select DM_GPIO

config TARGET_COLIBRI_IMX6
	bool "Toradex Colibri iIMX6 board"
	select BOARD_LATE_INIT
	select SUPPORT_SPL
	select DM
	select DM_SERIAL
	select DM_THERMAL

config TARGET_DHCOMIMX6
	bool "dh_imx6"
	select BOARD_LATE_INIT
	select BOARD_EARLY_INIT_F
	select SUPPORT_SPL
	select DM
	select DM_THERMAL
	imply CMD_SPL

config TARGET_DISPLAY5
	bool "LWN DISPLAY5 board"
	select SUPPORT_SPL
	select DM
	select DM_SERIAL

config TARGET_EMBESTIMX6BOARDS
	bool "embestimx6boards"
	select BOARD_LATE_INIT

config TARGET_GE_B450V3
	bool "General Electric B450v3"
	select BOARD_LATE_INIT
	select IMX6Q

config TARGET_GE_B650V3
	bool "General Electric B650v3"
	select BOARD_LATE_INIT
	select IMX6Q

config TARGET_GE_B850V3
	bool "General Electric B850v3"
	select BOARD_LATE_INIT
	select IMX6Q

config TARGET_GW_VENTANA
	bool "gw_ventana"
	select SUPPORT_SPL
	imply CMD_SATA
	imply CMD_SPL

config TARGET_KOSAGI_NOVENA
	bool "Kosagi Novena"
	select BOARD_LATE_INIT
	select SUPPORT_SPL

config TARGET_MCCMON6
	bool "mccmon6"
	select SUPPORT_SPL

config TARGET_IMX6CUBOXI
	bool "Solid-run imx6 boards"
	select BOARD_LATE_INIT
	select SUPPORT_SPL

config TARGET_IMX6LOGICPD
	bool "Logic PD i.IMX6 SOM"
	select BOARD_EARLY_INIT_F
	select BOARD_LATE_INIT
	select DM
	select DM_ETH
	select DM_GPIO
	select DM_I2C
	select DM_MMC
	select DM_PMIC
	select DM_REGULATOR
	select OF_CONTROL

config TARGET_IMX6QARM2
	bool "imx6qarm2"

config TARGET_IMX6Q_ENGICAM
	bool "Support Engicam i.Core(RQS)"
	select BOARD_LATE_INIT
	select IMX6QDL
	select OF_CONTROL
	select SPL_OF_LIBFDT
	select DM
	select DM_ETH
	select DM_GPIO
	select DM_I2C
	select DM_MMC
	select DM_THERMAL
	select SUPPORT_SPL
	select SPL_LOAD_FIT
	select SPL_DM if SPL
	select SPL_OF_CONTROL if SPL
	select SPL_SEPARATE_BSS if SPL
	select SPL_PINCTRL if SPL

config TARGET_IMX6SABREAUTO
	bool "imx6sabreauto"
	select BOARD_LATE_INIT
	select SUPPORT_SPL
	select DM
	select DM_THERMAL
	select BOARD_EARLY_INIT_F

config TARGET_IMX6SABRESD
	bool "imx6sabresd"
	select BOARD_LATE_INIT
	select SUPPORT_SPL
	select DM
	select DM_THERMAL
	select BOARD_EARLY_INIT_F

config TARGET_IMX6SLEVK
	bool "imx6slevk"
	select SUPPORT_SPL

config TARGET_IMX6SLLEVK
        bool "imx6sll evk"
	select BOARD_LATE_INIT
        select IMX6SLL
        select DM
        select DM_THERMAL

config TARGET_IMX6SXSABRESD
	bool "imx6sxsabresd"
	select IMX6SX
	select SUPPORT_SPL
	select DM
	select DM_THERMAL
	select BOARD_EARLY_INIT_F

config TARGET_IMX6SXSABREAUTO
        bool "imx6sxsabreauto"
	select BOARD_LATE_INIT
	select IMX6SX
        select DM
        select DM_THERMAL
	select BOARD_EARLY_INIT_F

config TARGET_IMX6UL_9X9_EVK
	bool "imx6ul_9x9_evk"
	select BOARD_LATE_INIT
	select IMX6UL
	select DM
	select DM_THERMAL
	select SUPPORT_SPL

config TARGET_IMX6UL_14X14_EVK
	select BOARD_LATE_INIT
	bool "imx6ul_14x14_evk"
	select IMX6UL
	select DM
	select DM_THERMAL
	select SUPPORT_SPL

config TARGET_IMX6UL_ENGICAM
	bool "Support Engicam GEAM6UL/Is.IoT"
	select BOARD_LATE_INIT
	select IMX6UL
	select OF_CONTROL
	select DM
	select DM_ETH
	select DM_GPIO
	select DM_I2C
	select DM_MMC
	select DM_THERMAL
	select SUPPORT_SPL
	select SPL_DM if SPL
	select SPL_OF_CONTROL if SPL
	select SPL_SEPARATE_BSS if SPL
	select SPL_PINCTRL if SPL

config TARGET_IMX6ULL_14X14_EVK
	bool "Support imx6ull_14x14_evk"
	select BOARD_LATE_INIT
	select IMX6ULL
	select DM
	select DM_THERMAL

config TARGET_NITROGEN6X
	bool "nitrogen6x"
	imply USB_HOST_ETHER
	imply USB_ETHER_ASIX
	imply USB_ETHER_SMSC95XX
	imply USB_ETHER_MCS7830

config TARGET_OPOS6ULDEV
	bool "Armadeus OPOS6ULDev board"
	select IMX6UL_OPOS6UL

config TARGET_OT1200
	bool "Bachmann OT1200"
	select SUPPORT_SPL
	imply CMD_SATA

config TARGET_PICO_IMX6UL
	bool "PICO-IMX6UL-EMMC"
	select IMX6UL

config TARGET_LITEBOARD
	bool "Grinn liteBoard (i.IMX6UL)"
	select BOARD_LATE_INIT
	select IMX6UL_LITESOM

config TARGET_PLATINUM_PICON
	bool "platinum-picon"
	select SUPPORT_SPL

config TARGET_PLATINUM_TITANIUM
	bool "platinum-titanium"
	select SUPPORT_SPL

config TARGET_PCM058
	bool "Phytec PCM058 i.IMX6 Quad"
	select BOARD_LATE_INIT
	select SUPPORT_SPL

config TARGET_PFLA02
	bool "Phytec PFLA02 (PhyFlex) i.IMX6 Quad"
	select BOARD_LATE_INIT
	select SUPPORT_SPL

config TARGET_SECOIMX6
	bool "secoimx6 boards"

config TARGET_TBS2910
	bool "TBS2910 Matrix ARM mini PC"

config TARGET_TITANIUM
	bool "titanium"

config TARGET_TQMA6
	bool "TQ Systems TQMa6 board"
	select BOARD_LATE_INIT

config TARGET_UDOO
	bool "udoo"
	select BOARD_LATE_INIT
	select SUPPORT_SPL

config TARGET_UDOO_NEO
	bool "UDOO Neo"
	select BOARD_LATE_INIT
	select SUPPORT_SPL
	select IMX6SX
	select DM
	select DM_THERMAL

config TARGET_SAMTEC_VINING_2000
	bool "samtec VIN|ING 2000"
	select BOARD_LATE_INIT
	select IMX6SX
	select DM
	select DM_THERMAL

config TARGET_WANDBOARD
	bool "wandboard"
	select BOARD_LATE_INIT
	select SUPPORT_SPL

config TARGET_WARP
	bool "WaRP"
	select BOARD_LATE_INIT

config TARGET_XPRESS
	bool "CCV xPress"
	select BOARD_LATE_INIT
	select IMX6UL
	select DM
	select DM_THERMAL
	select SUPPORT_SPL

config TARGET_ZC5202
	bool "zc5202"
	select BOARD_LATE_INIT
	select SUPPORT_SPL
	select DM
	select DM_THERMAL

config TARGET_ZC5601
	bool "zc5601"
	select BOARD_LATE_INIT
	select SUPPORT_SPL
	select DM
	select DM_THERMAL

endchoice

config SYS_SOC
	default "imx6"

source "board/ge/bx50v3/Kconfig"
source "board/advantech/dms-ba16/Kconfig"
source "board/aristainetos/Kconfig"
source "board/armadeus/opos6uldev/Kconfig"
source "board/bachmann/ot1200/Kconfig"
source "board/barco/platinum/Kconfig"
source "board/barco/titanium/Kconfig"
source "board/boundary/nitrogen6x/Kconfig"
source "board/ccv/xpress/Kconfig"
source "board/compulab/cm_fx6/Kconfig"
source "board/congatec/cgtqimx6eval/Kconfig"
source "board/dhelectronics/dh_imx6/Kconfig"
source "board/el/el6x/Kconfig"
source "board/embest/imx6boards/Kconfig"
source "board/engicam/imx6q/Kconfig"
source "board/engicam/imx6ul/Kconfig"
source "board/freescale/imx6qarm2/Kconfig"
source "board/freescale/imx6sabreauto/Kconfig"
source "board/freescale/imx6sabresd/Kconfig"
source "board/freescale/imx6slevk/Kconfig"
source "board/freescale/imx6sllevk/Kconfig"
source "board/freescale/imx6sxsabresd/Kconfig"
source "board/freescale/imx6sxsabreauto/Kconfig"
source "board/freescale/imx6ul_14x14_evk/Kconfig"
source "board/freescale/imx6ullevk/Kconfig"
source "board/grinn/liteboard/Kconfig"
source "board/phytec/pcm058/Kconfig"
source "board/phytec/pfla02/Kconfig"
source "board/gateworks/gw_ventana/Kconfig"
source "board/kosagi/novena/Kconfig"
source "board/samtec/vining_2000/Kconfig"
source "board/liebherr/display5/Kconfig"
source "board/liebherr/mccmon6/Kconfig"
source "board/logicpd/imx6/Kconfig"
source "board/seco/Kconfig"
source "board/solidrun/imx6cuboxi/Kconfig"
source "board/technexion/pico-imx6ul/Kconfig"
source "board/tbs/tbs2910/Kconfig"
source "board/tqc/tqma6/Kconfig"
source "board/toradex/apalis_imx6/Kconfig"
source "board/toradex/colibri_imx6/Kconfig"
source "board/udoo/Kconfig"
source "board/udoo/neo/Kconfig"
source "board/wandboard/Kconfig"
source "board/warp/Kconfig"

endif
```

## board/congatec/cgtqimx6eval/Kconfig
```kconfig
if TARGET_CGTQIMX6EVAL

config SYS_BOARD
	default "cgtqimx6eval"

config SYS_VENDOR
	default "congatec"

config SYS_CONFIG_NAME
	default "cgtqimx6eval"

endif
```

## board/congatec/cgtqmx6eval/Kconfig
```kconfig
if TARGET_CGTQIMX6EVAL

config SYS_BOARD
	default "cgtqmx6eval"

config SYS_VENDOR
	default "congatec"

config SYS_CONFIG_NAME
	default "cgtqmx6eval"

endif
```

## board/embest/imx6boards/Kconfig
```kconfig
if TARGET_EMBESTIMX6BOARDS

config SYS_BOARD
	default "imx6boards"

config SYS_VENDOR
	default "embest"

config SYS_CONFIG_NAME
	default "embestimx6boards"

endif
```

## board/freescale/imx6qarm2/Kconfig
```kconfig
if TARGET_IMX6QARM2

config SYS_BOARD
	default "imx6qarm2"

config SYS_VENDOR
	default "freescale"

config SYS_CONFIG_NAME
	default "imx6qarm2"

endif
```

## board/freescale/imx6sabreauto/Kconfig
```kconfig
if TARGET_IMX6SABREAUTO

config SYS_BOARD
	default "imx6sabreauto"

config SYS_VENDOR
	default "freescale"

config SYS_CONFIG_NAME
	default "imx6sabreauto"

endif
```

## board/freescale/imx6sabresd/Kconfig
```kconfig
if TARGET_IMX6SABRESD

config SYS_BOARD
	default "imx6sabresd"

config SYS_VENDOR
	default "freescale"

config SYS_CONFIG_NAME
	default "imx6sabresd"

endif
```

## board/freescale/imx6slevk/Kconfig
```kconfig
if TARGET_IMX6SLEVK

config SYS_BOARD
	default "imx6slevk"

config SYS_VENDOR
	default "freescale"

config SYS_CONFIG_NAME
	default "imx6slevk"

endif
```

## board/freescale/imx6sllevk/Kconfig
```kconfig
if TARGET_IMX6SLLEVK

config SYS_BOARD
	default "imx6sllevk"

config SYS_VENDOR
	default "freescale"

config SYS_CONFIG_NAME
	default "imx6sllevk"

endif
```

## board/freescale/imx6sxsabreauto/Kconfig
```kconfig
if TARGET_IMX6SXSABREAUTO

config SYS_BOARD
	default "imx6sxsabreauto"

config SYS_VENDOR
	default "freescale"

config SYS_CONFIG_NAME
	default "imx6sxsabreauto"

endif
```

## board/freescale/imx6sxsabresd/Kconfig
```kconfig
if TARGET_IMX6SXSABRESD

config SYS_BOARD
	default "imx6sxsabresd"

config SYS_VENDOR
	default "freescale"

config SYS_CONFIG_NAME
	default "imx6sxsabresd"

endif
```

## board/freescale/imx6ul_14x14_evk/Kconfig
```kconfig
if TARGET_IMX6UL_14X14_EVK || TARGET_IMX6UL_9X9_EVK

config SYS_BOARD
	default "imx6ul_14x14_evk"

config SYS_VENDOR
	default "freescale"

config SYS_CONFIG_NAME
	default "imx6ul_14x14_evk"

endif
```

## board/freescale/imx6ullevk/Kconfig
```kconfig
if TARGET_IMX6ULL_14X14_EVK

config SYS_BOARD
	default "imx6ullevk"

config SYS_VENDOR
	default "freescale"

config SYS_CONFIG_NAME
	default "imx6ullevk"

endif
```

## board/freescale/mx6qarm2/Kconfig
```kconfig
if TARGET_IMX6QARM2

config SYS_BOARD
	default "mx6qarm2"

config SYS_VENDOR
	default "freescale"

config SYS_CONFIG_NAME
	default "mx6qarm2"

endif
```

## board/seco/Kconfig
```kconfig
if TARGET_SECOIMX6

choice
	prompt "SECO i.IMX6 Board variant"
	optional

config SECOIMX6_Q7
	bool "Q7"

config SECOIMX6_UQ7
	bool "uQ7"

config SECOIMX6_USBC
	bool "uSBC"

endchoice

choice
	prompt "SECO i.IMX6 SoC variant"
	optional

config SECOIMX6Q
	bool "i.IMX6Q"
	select IMX6Q

config SECOIMX6DL
	bool "i.IMX6DL"
	select IMX6DL

config SECOIMX6S
	bool "i.IMX6S"
	select IMX6S

endchoice

choice
	prompt "DDR size"

config SECOIMX6_512MB
	bool "512MB"

config SECOIMX6_1GB
	bool "1GB"

config SECOIMX6_2GB
	bool "2GB"

config SECOIMX6_4GB
	bool "4GB"

endchoice

config IMX_CONFIG
	default "board/seco/mx6quq7/mx6quq7-2g.cfg" if SECOIMX6_UQ7 && SECOIMX6Q && SECOIMX6_2GB

config SYS_BOARD
	default "mx6quq7" if SECOIMX6_UQ7 && SECOIMX6Q

config SYS_VENDOR
	default "seco"

config SYS_CONFIG_NAME
	default "secomx6quq7" if SECOIMX6_UQ7 && SECOIMX6Q

endif
```

## board/solidrun/imx6cuboxi/Kconfig
```kconfig
if TARGET_IMX6CUBOXI

config SYS_BOARD
	default "imx6cuboxi"

config SYS_VENDOR
	default "solidrun"

config SYS_CONFIG_NAME
	default "imx6cuboxi"

endif
```

## drivers/clk/imx/Kconfig
```kconfig
config CLK_IMX
	bool "Clock support for i.MX SoCs"
	depends on ARCH_MX6
	select CLK
	help
	  This enables support for common clock driver API on i.MX
	  SoCs.

if CLK_IMX

config CLK_IMX6Q
	bool "Clock driver for i.MX6QDL"
	default MX6QDL
	help
	  This enables common clock driver support for platforms based
	  on i.MX6 QDL SoC.

config CLK_IMX6UL
	bool "Clock driver for i.MX6UL"
	default MX6UL
	help
	  This enables common clock driver support for platforms based
	  on i.MX6 UL SoC.

endif # CLK_IMX
```
